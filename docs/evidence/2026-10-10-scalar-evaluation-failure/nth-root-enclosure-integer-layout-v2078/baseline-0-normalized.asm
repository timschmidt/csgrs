0000: push   %rbp
0001: push   %r15
0003: push   %r14
0005: push   %r13
0007: push   %r12
0009: push   %rbx
000a: sub    $0x138,%rsp
0011: mov    %rsp,%rbx
0014: mov    %rbx,%rdi
0017: call   *RIP_ADDRESS(%rip)
001d: movq   $0x1,0x20(%rsp)
0026: lea    0xd0(%rsp),%rdi
002e: mov    %rbx,%rsi
0031: call   TARGET<<alloc::vec::Vec<alloc::string::String> as alloc::vec::spec_from_iter_nested::SpecFromIterNested<alloc::string::String, core::iter::adapters::skip::Skip<std::env::Args>>>::from_iter>
0036: mov    0xe0(%rsp),%rdi
003e: test   %rdi,%rdi
0041: je     LOCAL+0x156c
0047: cmp    $0x1,%rdi
004b: je     LOCAL+0x1575
0051: mov    0xd8(%rsp),%r9
0059: mov    0x20(%r9),%rcx
005d: mov    0x28(%r9),%rsi
0061: cmp    $0x1,%rsi
0065: je     LOCAL+0x75
0067: test   %rsi,%rsi
006a: je     LOCAL+0x1597
0070: movzbl (%rcx),%edx
0073: jmp    LOCAL+0x8c
0075: movzbl (%rcx),%edx
0078: mov    $0x1,%al
007a: cmp    $0x2b,%edx
007d: je     LOCAL+0x1403
0083: cmp    $0x2d,%edx
0086: je     LOCAL+0x1403
008c: xor    %eax,%eax
008e: cmp    $0x2b,%dl
0091: sete   %al
0094: mov    %rsi,%rdx
0097: sub    %rax,%rdx
009a: add    %rax,%rcx
009d: neg    %rax
00a0: cmp    $0x11,%rdx
00a4: jae    LOCAL+0xe7
00a6: test   %rdx,%rdx
00a9: je     LOCAL+0x139
00af: add    %rax,%rsi
00b2: neg    %rsi
00b5: xor    %r15d,%r15d
00b8: xor    %eax,%eax
00ba: nopw   0x0(%rax,%rax,1)
00c0: movzbl (%rcx,%rax,1),%edx
00c4: add    $0xffffffd0,%edx
00c7: cmp    $0x9,%edx
00ca: ja     LOCAL+0x1520
00d0: lea    (%r15,%r15,4),%rdi
00d4: mov    %edx,%edx
00d6: lea    (%rdx,%rdi,2),%r15
00da: inc    %rax
00dd: mov    %rsi,%rdx
00e0: add    %rax,%rdx
00e3: jne    LOCAL+0xc0
00e5: jmp    LOCAL+0x13c
00e7: add    %rax,%rsi
00ea: neg    %rsi
00ed: xor    %r15d,%r15d
00f0: mov    $0xa,%edi
00f5: xor    %r8d,%r8d
00f8: nopl   0x0(%rax,%rax,1)
0100: mov    %rsi,%rax
0103: add    %r8,%rax
0106: je     LOCAL+0x13c
0108: mov    %r15,%rax
010b: mul    %rdi
010e: movzbl (%rcx,%r8,1),%edx
0113: jo     LOCAL+0x13f9
0119: add    $0xffffffd0,%edx
011c: cmp    $0xa,%edx
011f: jae    LOCAL+0x1520
0125: mov    %rax,%r15
0128: mov    %edx,%eax
012a: inc    %r8
012d: add    %rax,%r15
0130: jae    LOCAL+0x100
0132: mov    $0x2,%al
0134: jmp    LOCAL+0x1403
0139: xor    %r15d,%r15d
013c: mov    0x10(%r9),%rcx
0140: add    $0xfffffffffffffff8,%rcx
0144: cmp    $0x6,%rcx
0148: ja     LOCAL+0x1502
014e: mov    0x8(%r9),%rax
0152: lea    RIP_ADDRESS(%rip),%rdx
0159: movslq (%rdx,%rcx,4),%rcx
015d: add    %rdx,%rcx
0160: mov    %r9,0x108(%rsp)
0168: jmp    *%rcx
016a: movabs $0x7061675f65646977,%rcx
0174: cmp    %rcx,(%rax)
0177: jne    LOCAL+0x1502
017d: mov    $0x7fffffff,%eax
0182: mov    $0xf4241,%ecx
0187: jmp    LOCAL+0x2cd
018c: movabs $0x6f635f6c6c616d73,%rcx
0196: xor    (%rax),%rcx
0199: mov    0x8(%rax),%edx
019c: xor    $0x65737261,%rdx
01a3: or     %rcx,%rdx
01a6: je     LOCAL+0x2c3
01ac: movabs $0x6c61685f65646977,%rcx
01b6: xor    (%rax),%rcx
01b9: mov    0x8(%rax),%eax
01bc: xor    $0x79617766,%rax
01c2: or     %rcx,%rax
01c5: jne    LOCAL+0x1502
01cb: mov    $0x1,%r12b
01ce: mov    $0xf4241,%eax
01d3: mov    %rax,0x50(%rsp)
01d8: mov    $0xf4241,%eax
01dd: jmp    LOCAL+0x2d5
01e2: movabs $0x69665f6c6c616d73,%rcx
01ec: xor    (%rax),%rcx
01ef: movzwl 0x8(%rax),%eax
01f3: xor    $0x656e,%rax
01f9: or     %rcx,%rax
01fc: jne    LOCAL+0x1502
0202: mov    $0xffffff80,%eax
0207: jmp    LOCAL+0x2c8
020c: movabs $0x64695f6c6c616d73,%rcx
0216: xor    (%rax),%rcx
0219: movabs $0x797469746e656469,%rdx
0223: xor    0x6(%rax),%rdx
0227: or     %rcx,%rdx
022a: jne    LOCAL+0x1502
0230: xor    %eax,%eax
0232: mov    $0x41,%ecx
0237: jmp    LOCAL+0x2cd
023c: movabs $0x616f635f65646977,%rcx
0246: xor    (%rax),%rcx
0249: movabs $0x657372616f635f65,%rdx
0253: xor    0x3(%rax),%rdx
0257: or     %rcx,%rdx
025a: jne    LOCAL+0x1502
0260: mov    $0xf4240,%eax
0265: mov    $0xf4241,%ecx
026a: jmp    LOCAL+0x2cd
026c: movabs $0x6e69665f65646977,%rcx
0276: xor    (%rax),%rcx
0279: movzbl 0x8(%rax),%eax
027d: xor    $0x65,%rax
0281: or     %rcx,%rax
0284: jne    LOCAL+0x1502
028a: mov    $0xffffff80,%eax
028f: mov    $0x10001,%ecx
0294: jmp    LOCAL+0x2cd
0296: movabs $0x6564695f65646977,%rcx
02a0: xor    (%rax),%rcx
02a3: movabs $0x797469746e656469,%rdx
02ad: xor    0x5(%rax),%rdx
02b1: or     %rcx,%rdx
02b4: jne    LOCAL+0x1502
02ba: xor    %eax,%eax
02bc: mov    $0x10001,%ecx
02c1: jmp    LOCAL+0x2cd
02c3: mov    $0x1,%eax
02c8: mov    $0x8,%ecx
02cd: mov    %rcx,0x50(%rsp)
02d2: xor    %r12d,%r12d
02d5: mov    %eax,0x74(%rsp)
02d9: call   *RIP_ADDRESS(%rip)
02df: mov    %rax,0x30(%rsp)
02e4: mov    %rdx,0x38(%rsp)
02e9: mov    %rsp,%rdi
02ec: lea    0x30(%rsp),%rsi
02f1: xor    %edx,%edx
02f3: call   *RIP_ADDRESS(%rip)
02f9: mov    (%rsp),%rax
02fd: mov    %rax,0xc8(%rsp)
0305: cmp    $0xffffffffffffffff,%rax
0309: je     LOCAL+0x145b
030f: lea    0x38(%rsp),%rbx
0314: mov    0x8(%rsp),%rax
0319: mov    %rax,0x78(%rsp)
031e: mov    0x10(%rsp),%rax
0323: mov    %rax,0x80(%rsp)
032b: movzbl 0x18(%rsp),%ebp
0330: mov    0x30(%rsp),%rax
0335: lock decq (%rax)
0339: jne    LOCAL+0x346
033b: lea    0x30(%rsp),%rdi
0340: call   *RIP_ADDRESS(%rip)
0346: mov    0x38(%rsp),%rax
034b: test   %rax,%rax
034e: je     LOCAL+0x35f
0350: lock decq (%rax)
0354: jne    LOCAL+0x35f
0356: mov    %rbx,%rdi
0359: call   *RIP_ADDRESS(%rip)
035f: call   *RIP_ADDRESS(%rip)
0365: mov    %rax,0x90(%rsp)
036d: mov    %rdx,0x98(%rsp)
0375: mov    %rsp,%rdi
0378: lea    0x90(%rsp),%rsi
0380: xor    %edx,%edx
0382: call   *RIP_ADDRESS(%rip)
0388: mov    (%rsp),%rax
038c: cmp    $0xffffffffffffffff,%rax
0390: je     LOCAL+0x1494
0396: mov    0x8(%rsp),%rcx
039b: mov    0x10(%rsp),%rsi
03a0: movzbl 0x18(%rsp),%r14d
03a6: test   %rsi,%rsi
03a9: je     LOCAL+0x417
03ab: mov    0x50(%rsp),%rdx
03b0: lea    -0x1(%rdx),%edi
03b3: mov    %edi,%edx
03b5: shr    $0x6,%edx
03b8: and    $0x3f,%dil
03bc: mov    %rax,(%rsp)
03c0: mov    %rcx,0x8(%rsp)
03c5: mov    %rsi,0x10(%rsp)
03ca: movzbl %dil,%ecx
03ce: lea    0x30(%rsp),%rdi
03d3: mov    %rsp,%rsi
03d6: call   *RIP_ADDRESS(%rip)
03dc: cmp    $0x1,%r14b
03e0: jne    LOCAL+0x430
03e2: mov    0x30(%rsp),%r13
03e7: mov    $0x1,%r14b
03ea: cmp    $0x4,%r13
03ee: jb     LOCAL+0x413
03f0: mov    0x38(%rsp),%rdi
03f5: shl    $0x3,%r13
03f9: mov    $0x8,%edx
03fe: mov    %r13,%rsi
0401: call   *RIP_ADDRESS(%rip)
0407: movq   $0x8,0x38(%rsp)
0410: xor    %r13d,%r13d
0413: xor    %ebx,%ebx
0415: jmp    LOCAL+0x44b
0417: mov    %rax,0x30(%rsp)
041c: mov    %rcx,0x38(%rsp)
0421: movq   $0x0,0x40(%rsp)
042a: cmp    $0x1,%r14b
042e: je     LOCAL+0x3e2
0430: mov    0x30(%rsp),%r13
0435: mov    0x40(%rsp),%rbx
043a: test   %rbx,%rbx
043d: movzbl %r14b,%eax
0441: mov    $0x1,%r14d
0447: cmovne %eax,%r14d
044b: mov    0x38(%rsp),%rax
0450: mov    %rax,0x28(%rsp)
0455: mov    0x90(%rsp),%rax
045d: lock decq (%rax)
0461: jne    LOCAL+0x471
0463: lea    0x90(%rsp),%rdi
046b: call   *RIP_ADDRESS(%rip)
0471: mov    0x98(%rsp),%rax
0479: test   %rax,%rax
047c: je     LOCAL+0x492
047e: lock decq (%rax)
0482: jne    LOCAL+0x492
0484: lea    0x98(%rsp),%rdi
048c: call   *RIP_ADDRESS(%rip)
0492: test   %r12b,%r12b
0495: je     LOCAL+0x4b4
0497: mov    %r13,(%rsp)
049b: mov    0x28(%rsp),%rax
04a0: mov    %rax,0x8(%rsp)
04a5: mov    %rbx,0x10(%rsp)
04aa: mov    %r14b,0x18(%rsp)
04af: jmp    LOCAL+0x91a
04b4: test   %r14b,%r14b
04b7: je     LOCAL+0x513
04b9: movzbl %r14b,%eax
04bd: cmp    $0x1,%eax
04c0: jne    LOCAL+0x5d8
04c6: lea    0x38(%rsp),%r14
04cb: movups RIP_ADDRESS(%rip),%xmm0
04d2: movaps %xmm0,0x30(%rsp)
04d7: movq   $0x0,0x40(%rsp)
04e0: lea    0x30(%rsp),%rdi
04e5: call   *RIP_ADDRESS(%rip)
04eb: mov    0x38(%rsp),%rax
04f0: movq   $0x1,(%rax)
04f7: movaps 0x30(%rsp),%xmm0
04fc: movaps %xmm0,(%rsp)
0500: movq   $0x1,0x10(%rsp)
0509: movb   $0x2,0x18(%rsp)
050e: jmp    LOCAL+0x62f
0513: lea    0x8(%rsp),%r14
0518: movups RIP_ADDRESS(%rip),%xmm0
051f: movaps %xmm0,(%rsp)
0523: movq   $0x0,0x10(%rsp)
052c: mov    %rsp,%rdi
052f: call   *RIP_ADDRESS(%rip)
0535: cmp    $0x2,%rbx
0539: setae  %al
053c: cmp    $0x1,%rbx
0540: sbb    $0x0,%al
0542: mov    0x8(%rsp),%rcx
0547: movq   $0x1,(%rcx)
054e: mov    (%rsp),%r12
0552: mov    0x8(%rsp),%r14
0557: cmp    $0x1,%rbx
055b: jne    LOCAL+0x573
055d: mov    (%r14),%rax
0560: mov    0x28(%rsp),%rcx
0565: cmp    %rax,(%rcx)
0568: je     LOCAL+0x5fe
056e: seta   %al
0571: sbb    $0x0,%al
0573: test   %al,%al
0575: je     LOCAL+0x5fe
057b: movzbl %al,%eax
057e: cmp    $0x1,%eax
0581: jne    LOCAL+0x740
0587: mov    %r13,(%rsp)
058b: mov    0x28(%rsp),%rax
0590: mov    %rax,0x8(%rsp)
0595: mov    %rbx,0x10(%rsp)
059a: mov    %rsp,%rdi
059d: mov    $0x1,%esi
05a2: call   *RIP_ADDRESS(%rip)
05a8: mov    (%rsp),%rsi
05ac: mov    0x8(%rsp),%rdi
05b1: mov    0x10(%rsp),%rax
05b6: test   %rax,%rax
05b9: je     LOCAL+0x890
05bf: mov    %rsi,(%rsp)
05c3: mov    %rdi,0x8(%rsp)
05c8: mov    %rax,0x10(%rsp)
05cd: xor    %ebx,%ebx
05cf: mov    %bl,0x18(%rsp)
05d3: jmp    LOCAL+0x900
05d8: mov    %r13,(%rsp)
05dc: mov    0x28(%rsp),%rax
05e1: mov    %rax,0x8(%rsp)
05e6: mov    %rbx,0x10(%rsp)
05eb: test   %rbx,%rbx
05ee: je     LOCAL+0x64e
05f0: incq   (%rax)
05f3: je     LOCAL+0x684
05f9: jmp    LOCAL+0x715
05fe: movups RIP_ADDRESS(%rip),%xmm0
0605: movaps %xmm0,0x10(%rsp)
060a: movups RIP_ADDRESS(%rip),%xmm0
0611: movaps %xmm0,(%rsp)
0615: test   %r12,%r12
0618: je     LOCAL+0x62f
061a: shl    $0x3,%r12
061e: mov    $0x8,%edx
0623: mov    %r14,%rdi
0626: mov    %r12,%rsi
0629: call   *RIP_ADDRESS(%rip)
062f: test   %r13,%r13
0632: je     LOCAL+0x91a
0638: shl    $0x3,%r13
063c: mov    $0x8,%edx
0641: mov    0x28(%rsp),%rdi
0646: mov    %r13,%rsi
0649: jmp    LOCAL+0x914
064e: test   %r13,%r13
0651: jne    LOCAL+0x661
0653: mov    %rsp,%rdi
0656: call   *RIP_ADDRESS(%rip)
065c: mov    0x8(%rsp),%rax
0661: movq   $0x0,(%rax)
0668: movq   $0x1,0x10(%rsp)
0671: mov    $0x1,%ebx
0676: mov    0x8(%rsp),%rax
067b: incq   (%rax)
067e: jne    LOCAL+0x715
0684: mov    $0x1,%r14d
068a: cmp    $0x1,%rbx
068e: je     LOCAL+0x6b9
0690: mov    %rax,%rdx
0693: shl    $0x3,%rbx
0697: mov    $0x1,%al
0699: mov    $0x8,%ecx
069e: xchg   %ax,%ax
06a0: add    $0xff,%al
06a2: adcq   $0x0,(%rdx,%rcx,1)
06a7: setb   %al
06aa: jae    LOCAL+0x715
06ac: add    $0x8,%rcx
06b0: cmp    %rcx,%rbx
06b3: jne    LOCAL+0x6a0
06b5: movzbl %al,%r14d
06b9: mov    0x10(%rsp),%rbx
06be: cmp    (%rsp),%rbx
06c2: jne    LOCAL+0x6cd
06c4: mov    %rsp,%rdi
06c7: call   *RIP_ADDRESS(%rip)
06cd: mov    0x8(%rsp),%rax
06d2: mov    %r14,(%rax,%rbx,8)
06d6: inc    %rbx
06d9: mov    (%rsp),%rsi
06dd: mov    0x8(%rsp),%rdi
06e2: test   %rbx,%rbx
06e5: jne    LOCAL+0x728
06e7: movups RIP_ADDRESS(%rip),%xmm0
06ee: movaps %xmm0,0x10(%rsp)
06f3: movups RIP_ADDRESS(%rip),%xmm0
06fa: movaps %xmm0,(%rsp)
06fe: test   %rsi,%rsi
0701: je     LOCAL+0x91a
0707: shl    $0x3,%rsi
070b: mov    $0x8,%edx
0710: jmp    LOCAL+0x914
0715: mov    0x10(%rsp),%rbx
071a: mov    (%rsp),%rsi
071e: mov    0x8(%rsp),%rdi
0723: test   %rbx,%rbx
0726: je     LOCAL+0x6e7
0728: mov    %rsi,(%rsp)
072c: mov    %rdi,0x8(%rsp)
0731: mov    %rbx,0x10(%rsp)
0736: movb   $0x2,0x18(%rsp)
073b: jmp    LOCAL+0x91a
0740: mov    %r13,(%rsp)
0744: mov    0x28(%rsp),%rdx
0749: mov    %rdx,0x8(%rsp)
074e: mov    %rbx,0x10(%rsp)
0753: test   %rbx,%rbx
0756: mov    %r14,0x88(%rsp)
075e: je     LOCAL+0x794
0760: movq   $0x1,0x30(%rsp)
0769: lea    0x30(%rsp),%rdi
076e: mov    $0x1,%esi
0773: mov    %rbx,%rcx
0776: call   *RIP_ADDRESS(%rip)
077c: mov    0x10(%rsp),%r14
0781: mov    (%rsp),%r13
0785: mov    0x8(%rsp),%rbx
078a: test   %r14,%r14
078d: jne    LOCAL+0x7d0
078f: xor    %r14d,%r14d
0792: jmp    LOCAL+0x810
0794: test   %r13,%r13
0797: jne    LOCAL+0x7ac
0799: mov    %rsp,%rdi
079c: call   *RIP_ADDRESS(%rip)
07a2: mov    0x8(%rsp),%rax
07a7: mov    %rax,0x28(%rsp)
07ac: mov    0x28(%rsp),%rax
07b1: movq   $0x1,(%rax)
07b8: movq   $0x1,0x10(%rsp)
07c1: mov    (%rsp),%r13
07c5: mov    0x8(%rsp),%rbx
07ca: mov    $0x1,%r14d
07d0: cmpq   $0x0,-0x8(%rbx,%r14,8)
07d6: jne    LOCAL+0x810
07d8: movabs $0x1fffffffffffffff,%rax
07e2: and    %r14,%rax
07e5: lea    0x0(,%r14,8),%rdx
07ed: xor    %ecx,%ecx
07ef: test   %rdx,%rdx
07f2: je     LOCAL+0x78f
07f4: inc    %rcx
07f7: cmpq   $0x0,-0x8(%rbx,%rdx,1)
07fd: lea    -0x8(%rdx),%rdx
0801: je     LOCAL+0x7ef
0803: sub    %rcx,%rax
0806: inc    %rax
0809: cmp    %r14,%rax
080c: cmovb  %rax,%r14
0810: mov    %r13,%rax
0813: shr    $0x2,%rax
0817: cmp    %rax,%r14
081a: jae    LOCAL+0x86e
081c: cmp    %r13,%r14
081f: ja     LOCAL+0x1539
0825: test   %r13,%r13
0828: je     LOCAL+0x86e
082a: shl    $0x3,%r13
082e: test   %r14,%r14
0831: je     LOCAL+0x142e
0837: mov    %r12,0x28(%rsp)
083c: lea    0x0(,%r14,8),%r12
0844: mov    $0x8,%edx
0849: mov    %rbx,%rdi
084c: mov    %r13,%rsi
084f: mov    %r12,%rcx
0852: call   *RIP_ADDRESS(%rip)
0858: test   %rax,%rax
085b: je     LOCAL+0x15da
0861: mov    %rax,%rbx
0864: mov    %r14,%r13
0867: mov    0x28(%rsp),%r12
086c: jmp    LOCAL+0x873
086e: test   %r14,%r14
0871: je     LOCAL+0x8c7
0873: mov    %r13,(%rsp)
0877: mov    %rbx,0x8(%rsp)
087c: mov    %r14,0x10(%rsp)
0881: movb   $0x2,0x18(%rsp)
0886: mov    0x88(%rsp),%r14
088e: jmp    LOCAL+0x900
0890: movups RIP_ADDRESS(%rip),%xmm0
0897: movaps %xmm0,0x10(%rsp)
089c: movups RIP_ADDRESS(%rip),%xmm0
08a3: movaps %xmm0,(%rsp)
08a7: mov    $0x1,%bl
08a9: test   %rsi,%rsi
08ac: je     LOCAL+0x5cf
08b2: shl    $0x3,%rsi
08b6: mov    $0x8,%edx
08bb: call   *RIP_ADDRESS(%rip)
08c1: mov    %bl,0x18(%rsp)
08c5: jmp    LOCAL+0x900
08c7: movups RIP_ADDRESS(%rip),%xmm0
08ce: movaps %xmm0,0x10(%rsp)
08d3: movups RIP_ADDRESS(%rip),%xmm0
08da: movaps %xmm0,(%rsp)
08de: test   %r13,%r13
08e1: mov    0x88(%rsp),%r14
08e9: je     LOCAL+0x900
08eb: shl    $0x3,%r13
08ef: mov    $0x8,%edx
08f4: mov    %rbx,%rdi
08f7: mov    %r13,%rsi
08fa: call   *RIP_ADDRESS(%rip)
0900: test   %r12,%r12
0903: je     LOCAL+0x91a
0905: shl    $0x3,%r12
0909: mov    $0x8,%edx
090e: mov    %r14,%rdi
0911: mov    %r12,%rsi
0914: call   *RIP_ADDRESS(%rip)
091a: mov    %rsp,%rdi
091d: call   *RIP_ADDRESS(%rip)
0923: mov    %rax,%rdi
0926: call   *RIP_ADDRESS(%rip)
092c: mov    %rax,%r12
092f: mov    %rdx,%rbx
0932: mov    %rax,0x118(%rsp)
093a: mov    %rdx,0x120(%rsp)
0942: lock incq (%rax)
0946: jle    LOCAL+0x15e8
094c: test   %rbx,%rbx
094f: je     LOCAL+0x95b
0951: lock incq (%rbx)
0955: jle    LOCAL+0x15e8
095b: mov    %r12,%rdi
095e: mov    %rbx,%rsi
0961: call   *RIP_ADDRESS(%rip)
0967: mov    %r12,0x90(%rsp)
096f: mov    %rbx,0x98(%rsp)
0977: mov    %rax,0xa0(%rsp)
097f: mov    %rdx,0xa8(%rsp)
0987: lea    0xb0(%rsp),%rax
098f: lea    0x90(%rsp),%rcx
0997: mov    %rcx,(%rsp)
099b: mov    %rax,0x8(%rsp)
09a0: lea    0x74(%rsp),%rax
09a5: mov    %rax,0x10(%rsp)
09aa: lea    0xe8(%rsp),%rdi
09b2: mov    %rsp,%rsi
09b5: call   TARGET<<alloc::vec::Vec<num_bigint::bigint::BigInt> as alloc::vec::spec_from_iter_nested::SpecFromIterNested<num_bigint::bigint::BigInt, core::iter::adapters::map::Map<core::slice::iter::Iter<hyperreal::computable::node::Computable>, probe::main::{closure
09ba: test   %r15,%r15
09bd: je     LOCAL+0xae2
09c3: mov    0xf0(%rsp),%rax
09cb: mov    0xf8(%rsp),%rsi
09d3: xor    %r12d,%r12d
09d6: xor    %ecx,%ecx
09d8: jmp    LOCAL+0x9fd
09da: nopw   0x0(%rax,%rax,1)
09e0: sub    %r10b,%dil
09e3: inc    %rcx
09e6: shr    $0x7,%dil
09ea: movzbl %dil,%edi
09ee: add    %rdx,%r12
09f1: add    %rdi,%r12
09f4: cmp    %r15,%rcx
09f7: je     LOCAL+0xae5
09fd: mov    %ecx,%edi
09ff: and    $0x1,%edi
0a02: cmp    %rsi,%rdi
0a05: jae    LOCAL+0x1527
0a0b: shl    $0x5,%edi
0a0e: mov    0x8(%rax,%rdi,1),%r8
0a13: mov    0x10(%rax,%rdi,1),%r9
0a18: test   %r9,%r9
0a1b: je     LOCAL+0xa40
0a1d: mov    $0x7f,%edx
0a22: bsr    -0x8(%r8,%r9,8),%rdx
0a28: xor    $0x3f,%rdx
0a2c: mov    %r9,%r10
0a2f: shl    $0x6,%r10
0a33: sub    %rdx,%r10
0a36: lea    (%r10,%r10,2),%rdx
0a3a: jmp    LOCAL+0xa42
0a3c: nopl   0x0(%rax)
0a40: xor    %edx,%edx
0a42: add    %rax,%rdi
0a45: movzbl 0x18(%rdi),%r11d
0a4a: cmp    %rbp,%r11
0a4d: setl   %r10b
0a51: setg   %dil
0a55: cmp    %bpl,%r11b
0a58: jne    LOCAL+0x9e0
0a5a: cmp    $0x2,%rbp
0a5e: je     LOCAL+0xa6c
0a60: cmp    $0x1,%ebp
0a63: jne    LOCAL+0xa92
0a65: xor    %edi,%edi
0a67: jmp    LOCAL+0x9e3
0a6c: mov    0x80(%rsp),%r10
0a74: cmp    %r10,%r9
0a77: seta   %dil
0a7b: sbb    $0x0,%dil
0a7f: cmp    %r10,%r9
0a82: jne    LOCAL+0x9e3
0a88: mov    %r8,%rdi
0a8b: mov    0x78(%rsp),%r8
0a90: jmp    LOCAL+0xab3
0a92: mov    0x80(%rsp),%r10
0a9a: cmp    %r9,%r10
0a9d: seta   %dil
0aa1: sbb    $0x0,%dil
0aa5: cmp    %r9,%r10
0aa8: jne    LOCAL+0x9e3
0aae: mov    0x78(%rsp),%rdi
0ab3: shl    $0x3,%r9
0ab7: nopw   0x0(%rax,%rax,1)
0ac0: test   %r9,%r9
0ac3: je     LOCAL+0xa65
0ac5: mov    -0x8(%r8,%r9,1),%r10
0aca: cmp    %r10,-0x8(%rdi,%r9,1)
0acf: lea    -0x8(%r9),%r9
0ad3: je     LOCAL+0xac0
0ad5: seta   %dil
0ad9: sbb    $0x0,%dil
0add: jmp    LOCAL+0x9e3
0ae2: xor    %r12d,%r12d
0ae5: mov    %r12,0x110(%rsp)
0aed: movq   $0x0,0x100(%rsp)
0af9: call   *RIP_ADDRESS(%rip)
0aff: mov    %rax,0x128(%rsp)
0b07: mov    %edx,0x130(%rsp)
0b0e: xor    %r13d,%r13d
0b11: test   %r15,%r15
0b14: je     LOCAL+0xc84
0b1a: mov    %rsp,%rbx
0b1d: xor    %r14d,%r14d
0b20: jmp    LOCAL+0xb3c
0b22: data16 data16 data16 data16 cs nopw 0x0(%rax,%rax,1)
0b30: inc    %r14
0b33: cmp    %r15,%r14
0b36: je     LOCAL+0xc84
0b3c: mov    %r14d,%eax
0b3f: and    $0x1,%eax
0b42: shl    $0x4,%eax
0b45: lea    (%rsp,%rax,1),%rsi
0b49: add    $0x90,%rsi
0b50: mov    0x74(%rsp),%edx
0b54: mov    %rbx,%rdi
0b57: call   *RIP_ADDRESS(%rip)
0b5d: cmpq   $0xffffffffffffffff,(%rsp)
0b62: je     LOCAL+0x13c6
0b68: movups (%rsp),%xmm0
0b6c: movups 0x10(%rsp),%xmm1
0b71: movaps %xmm1,0x40(%rsp)
0b76: movaps %xmm0,0x30(%rsp)
0b7b: lea    0x30(%rsp),%rax
0b80: mov    0x38(%rsp),%rdi
0b85: mov    0x40(%rsp),%rcx
0b8a: test   %rcx,%rcx
0b8d: je     LOCAL+0xbb0
0b8f: mov    $0x7f,%eax
0b94: bsr    -0x8(%rdi,%rcx,8),%rax
0b9a: xor    $0x3f,%rax
0b9e: mov    %rcx,%rdx
0ba1: shl    $0x6,%rdx
0ba5: sub    %rax,%rdx
0ba8: lea    (%rdx,%rdx,2),%rax
0bac: jmp    LOCAL+0xbb2
0bae: xchg   %ax,%ax
0bb0: xor    %eax,%eax
0bb2: movzbl 0x48(%rsp),%r8d
0bb8: cmp    %rbp,%r8
0bbb: setl   %sil
0bbf: setg   %dl
0bc2: cmp    %bpl,%r8b
0bc5: jne    LOCAL+0xbe0
0bc7: cmp    $0x2,%rbp
0bcb: je     LOCAL+0xc19
0bcd: cmp    $0x1,%ebp
0bd0: jne    LOCAL+0xc39
0bd2: xor    %edx,%edx
0bd4: jmp    LOCAL+0xbe3
0bd6: cs nopw 0x0(%rax,%rax,1)
0be0: sub    %sil,%dl
0be3: shr    $0x7,%dl
0be6: movzbl %dl,%ecx
0be9: add    %rax,%r13
0bec: add    %rcx,%r13
0bef: mov    %r13,0x100(%rsp)
0bf7: mov    0x30(%rsp),%rsi
0bfc: test   %rsi,%rsi
0bff: je     LOCAL+0xb30
0c05: shl    $0x3,%rsi
0c09: mov    $0x8,%edx
0c0e: call   *RIP_ADDRESS(%rip)
0c14: jmp    LOCAL+0xb30
0c19: mov    0x80(%rsp),%rsi
0c21: cmp    %rsi,%rcx
0c24: seta   %dl
0c27: sbb    $0x0,%dl
0c2a: cmp    %rsi,%rcx
0c2d: jne    LOCAL+0xbe3
0c2f: mov    %rdi,%rdx
0c32: mov    0x78(%rsp),%rsi
0c37: jmp    LOCAL+0xc57
0c39: mov    0x80(%rsp),%rsi
0c41: cmp    %rcx,%rsi
0c44: seta   %dl
0c47: sbb    $0x0,%dl
0c4a: cmp    %rcx,%rsi
0c4d: jne    LOCAL+0xbe3
0c4f: mov    0x78(%rsp),%rdx
0c54: mov    %rdi,%rsi
0c57: shl    $0x3,%rcx
0c5b: nopl   0x0(%rax,%rax,1)
0c60: test   %rcx,%rcx
0c63: je     LOCAL+0xbd2
0c69: mov    -0x8(%rsi,%rcx,1),%r8
0c6e: cmp    %r8,-0x8(%rdx,%rcx,1)
0c73: lea    -0x8(%rcx),%rcx
0c77: je     LOCAL+0xc60
0c79: seta   %dl
0c7c: sbb    $0x0,%dl
0c7f: jmp    LOCAL+0xbe3
0c84: lea    0x128(%rsp),%rdi
0c8c: call   *RIP_ADDRESS(%rip)
0c92: mov    %edx,%ecx
0c94: mov    $0x3b9aca00,%edx
0c99: mul    %rdx
0c9c: mov    %ecx,%ecx
0c9e: add    %rax,%rcx
0ca1: adc    $0x0,%rdx
0ca5: cmp    %r12,%r13
0ca8: jne    LOCAL+0x14c7
0cae: mov    %rcx,%r13
0cb1: mov    %rdx,0x80(%rsp)
0cb9: movq   $0x0,0xb0(%rsp)
0cc5: movq   $0x0,0xc0(%rsp)
0cd1: call   *RIP_ADDRESS(%rip)
0cd7: mov    $0x4,%ebx
0cdc: mov    $0x1,%ebp
0ce1: mov    $0x4,%edi
0ce6: mov    $0x1,%esi
0ceb: call   *RIP_ADDRESS(%rip)
0cf1: test   %rax,%rax
0cf4: je     LOCAL+0x155c
0cfa: movl   $0x65736163,(%rax)
0d00: movq   $0x4,0x58(%rsp)
0d09: mov    %rax,0x60(%rsp)
0d0e: movq   $0x4,0x68(%rsp)
0d17: mov    0x108(%rsp),%rcx
0d1f: mov    0x10(%rcx),%rbx
0d23: test   %rbx,%rbx
0d26: je     LOCAL+0xd60
0d28: mov    %rax,0x28(%rsp)
0d2d: mov    0x8(%rcx),%r14
0d31: call   *RIP_ADDRESS(%rip)
0d37: mov    $0x1,%esi
0d3c: mov    %rbx,%rdi
0d3f: call   *RIP_ADDRESS(%rip)
0d45: test   %rax,%rax
0d48: je     LOCAL+0x1587
0d4e: mov    %rax,%rbp
0d51: mov    %rax,%rdi
0d54: mov    %r14,%rsi
0d57: mov    %rbx,%rdx
0d5a: call   *RIP_ADDRESS(%rip)
0d60: movb   $0x3,(%rsp)
0d64: mov    %rbx,0x8(%rsp)
0d69: mov    %rbp,0x10(%rsp)
0d6e: mov    %rbx,0x18(%rsp)
0d73: lea    0x30(%rsp),%rdi
0d78: lea    0xb0(%rsp),%rsi
0d80: lea    0x58(%rsp),%rdx
0d85: mov    %rsp,%rcx
0d88: call   TARGET<<alloc::collections::btree::map::BTreeMap<alloc::string::String, serde_json::value::Value>>::insert>
0d8d: cmpb   $0xff,0x30(%rsp)
0d92: je     LOCAL+0xd9e
0d94: lea    0x30(%rsp),%rdi
0d99: call   TARGET<core::ptr::drop_glue::<serde_json::value::Value>>
0d9e: call   *RIP_ADDRESS(%rip)
0da4: mov    $0xa,%ebx
0da9: mov    $0xa,%edi
0dae: mov    $0x1,%esi
0db3: call   *RIP_ADDRESS(%rip)
0db9: test   %rax,%rax
0dbc: je     LOCAL+0x155c
0dc2: movabs $0x6f69746172657469,%rcx
0dcc: mov    %rcx,(%rax)
0dcf: movw   $0x736e,0x8(%rax)
0dd5: movq   $0xa,0x58(%rsp)
0dde: mov    %rax,0x60(%rsp)
0de3: movq   $0xa,0x68(%rsp)
0dec: movb   $0x2,(%rsp)
0df0: movq   $0x0,0x8(%rsp)
0df9: mov    %r15,0x10(%rsp)
0dfe: lea    0x30(%rsp),%rdi
0e03: lea    0xb0(%rsp),%rsi
0e0b: lea    0x58(%rsp),%rdx
0e10: mov    %rsp,%rcx
0e13: call   TARGET<<alloc::collections::btree::map::BTreeMap<alloc::string::String, serde_json::value::Value>>::insert>
0e18: cmpb   $0xff,0x30(%rsp)
0e1d: je     LOCAL+0xe29
0e1f: lea    0x30(%rsp),%rdi
0e24: call   TARGET<core::ptr::drop_glue::<serde_json::value::Value>>
0e29: call   *RIP_ADDRESS(%rip)
0e2f: mov    $0x4,%ebx
0e34: mov    $0x4,%edi
0e39: mov    $0x1,%esi
0e3e: call   *RIP_ADDRESS(%rip)
0e44: test   %rax,%rax
0e47: je     LOCAL+0x155c
0e4d: movl   $0x73746962,(%rax)
0e53: movq   $0x4,0x58(%rsp)
0e5c: mov    %rax,0x60(%rsp)
0e61: movq   $0x4,0x68(%rsp)
0e6a: mov    0x50(%rsp),%eax
0e6e: movb   $0x2,(%rsp)
0e72: movq   $0x0,0x8(%rsp)
0e7b: mov    %rax,0x10(%rsp)
0e80: lea    0x30(%rsp),%rdi
0e85: lea    0xb0(%rsp),%rsi
0e8d: lea    0x58(%rsp),%rdx
0e92: mov    %rsp,%rcx
0e95: call   TARGET<<alloc::collections::btree::map::BTreeMap<alloc::string::String, serde_json::value::Value>>::insert>
0e9a: cmpb   $0xff,0x30(%rsp)
0e9f: je     LOCAL+0xeab
0ea1: lea    0x30(%rsp),%rdi
0ea6: call   TARGET<core::ptr::drop_glue::<serde_json::value::Value>>
0eab: call   *RIP_ADDRESS(%rip)
0eb1: mov    $0x9,%ebx
0eb6: mov    $0x9,%edi
0ebb: mov    $0x1,%esi
0ec0: call   *RIP_ADDRESS(%rip)
0ec6: test   %rax,%rax
0ec9: je     LOCAL+0x155c
0ecf: movabs $0x6f69736963657270,%rcx
0ed9: mov    %rcx,(%rax)
0edc: movb   $0x6e,0x8(%rax)
0ee0: movq   $0x9,0x58(%rsp)
0ee9: mov    %rax,0x60(%rsp)
0eee: movq   $0x9,0x68(%rsp)
0ef7: movslq 0x74(%rsp),%rax
0efc: mov    %rax,%rcx
0eff: shr    $0x3f,%rcx
0f03: movb   $0x2,(%rsp)
0f07: mov    %rcx,0x8(%rsp)
0f0c: mov    %rax,0x10(%rsp)
0f11: lea    0x30(%rsp),%rdi
0f16: lea    0xb0(%rsp),%rsi
0f1e: lea    0x58(%rsp),%rdx
0f23: mov    %rsp,%rcx
0f26: call   TARGET<<alloc::collections::btree::map::BTreeMap<alloc::string::String, serde_json::value::Value>>::insert>
0f2b: cmpb   $0xff,0x30(%rsp)
0f30: je     LOCAL+0xf3c
0f32: lea    0x30(%rsp),%rdi
0f37: call   TARGET<core::ptr::drop_glue::<serde_json::value::Value>>
0f3c: call   *RIP_ADDRESS(%rip)
0f42: mov    $0xa,%ebx
0f47: mov    $0xa,%edi
0f4c: mov    $0x1,%esi
0f51: call   *RIP_ADDRESS(%rip)
0f57: test   %rax,%rax
0f5a: je     LOCAL+0x155c
0f60: mov    %rax,%rbp
0f63: movabs $0x5f64657370616c65,%rax
0f6d: mov    %rax,0x0(%rbp)
0f71: movw   $0x736e,0x8(%rbp)
0f77: movq   $0xa,0x58(%rsp)
0f80: mov    %rbp,0x60(%rsp)
0f85: movq   $0xa,0x68(%rsp)
0f8e: mov    %rsp,%rdx
0f91: mov    $0x27,%ecx
0f96: mov    %r13,%rdi
0f99: mov    0x80(%rsp),%rsi
0fa1: call   *RIP_ADDRESS(%rip)
0fa7: mov    %rdx,%rbx
0faa: test   %rdx,%rdx
0fad: jns    LOCAL+0xfc3
0faf: xor    %r15d,%r15d
0fb2: mov    %r15,%rdi
0fb5: mov    %rbx,%rsi
0fb8: call   *RIP_ADDRESS(%rip)
0fbe: jmp    LOCAL+0x15e8
0fc3: test   %rbx,%rbx
0fc6: je     LOCAL+0x102d
0fc8: mov    %rax,%r14
0fcb: call   *RIP_ADDRESS(%rip)
0fd1: mov    $0x1,%r15d
0fd7: mov    $0x1,%esi
0fdc: mov    %rbx,%rdi
0fdf: call   *RIP_ADDRESS(%rip)
0fe5: test   %rax,%rax
0fe8: je     LOCAL+0xfb2
0fea: mov    %rax,%r13
0fed: mov    %rax,%rdi
0ff0: mov    %r14,%rsi
0ff3: mov    %rbx,%rdx
0ff6: call   *RIP_ADDRESS(%rip)
0ffc: call   *RIP_ADDRESS(%rip)
1002: mov    $0x1,%esi
1007: mov    %rbx,%rdi
100a: call   *RIP_ADDRESS(%rip)
1010: test   %rax,%rax
1013: je     LOCAL+0x15ca
1019: mov    %rax,%r14
101c: mov    %rax,%rdi
101f: mov    %r13,%rsi
1022: mov    %rbx,%rdx
1025: call   *RIP_ADDRESS(%rip)
102b: jmp    LOCAL+0x1039
102d: mov    $0x1,%r13d
1033: mov    $0x1,%r14d
1039: movb   $0x3,(%rsp)
103d: mov    %rbx,0x8(%rsp)
1042: mov    %r14,0x10(%rsp)
1047: mov    %rbx,0x18(%rsp)
104c: lea    0x30(%rsp),%rdi
1051: lea    0xb0(%rsp),%rsi
1059: lea    0x58(%rsp),%rdx
105e: mov    %rsp,%rcx
1061: call   TARGET<<alloc::collections::btree::map::BTreeMap<alloc::string::String, serde_json::value::Value>>::insert>
1066: cmpb   $0xff,0x30(%rsp)
106b: je     LOCAL+0x1077
106d: lea    0x30(%rsp),%rdi
1072: call   TARGET<core::ptr::drop_glue::<serde_json::value::Value>>
1077: test   %rbx,%rbx
107a: je     LOCAL+0x108d
107c: mov    $0x1,%edx
1081: mov    %r13,%rdi
1084: mov    %rbx,%rsi
1087: call   *RIP_ADDRESS(%rip)
108d: call   *RIP_ADDRESS(%rip)
1093: mov    $0x8,%ebx
1098: mov    $0x8,%edi
109d: mov    $0x1,%esi
10a2: call   *RIP_ADDRESS(%rip)
10a8: test   %rax,%rax
10ab: je     LOCAL+0x155c
10b1: movabs $0x6d75736b63656863,%rcx
10bb: mov    %rcx,(%rax)
10be: movq   $0x8,0x58(%rsp)
10c7: mov    %rax,0x60(%rsp)
10cc: movq   $0x8,0x68(%rsp)
10d5: movb   $0x2,(%rsp)
10d9: movq   $0x0,0x8(%rsp)
10e2: mov    %r12,0x10(%rsp)
10e7: lea    0x30(%rsp),%rdi
10ec: lea    0xb0(%rsp),%rsi
10f4: lea    0x58(%rsp),%rdx
10f9: mov    %rsp,%rcx
10fc: call   TARGET<<alloc::collections::btree::map::BTreeMap<alloc::string::String, serde_json::value::Value>>::insert>
1101: cmpb   $0xff,0x30(%rsp)
1106: je     LOCAL+0x1112
1108: lea    0x30(%rsp),%rdi
110d: call   TARGET<core::ptr::drop_glue::<serde_json::value::Value>>
1112: call   *RIP_ADDRESS(%rip)
1118: mov    $0xd,%ebx
111d: mov    $0xd,%edi
1122: mov    $0x1,%esi
1127: call   *RIP_ADDRESS(%rip)
112d: test   %rax,%rax
1130: je     LOCAL+0x155c
1136: mov    %rax,%r12
1139: movabs $0x737469625f646574,%rax
1143: mov    %rax,0x5(%r12)
1148: movabs $0x6465746365707865,%rax
1152: mov    %rax,(%r12)
1156: movq   $0xd,0x58(%rsp)
115f: mov    %r12,0x60(%rsp)
1164: movq   $0xd,0x68(%rsp)
116d: call   *RIP_ADDRESS(%rip)
1173: mov    $0x40,%edi
1178: mov    $0x8,%esi
117d: call   *RIP_ADDRESS(%rip)
1183: test   %rax,%rax
1186: je     LOCAL+0x14ed
118c: mov    %rax,%r13
118f: mov    0xf8(%rsp),%r15
1197: test   %r15,%r15
119a: je     LOCAL+0x159e
11a0: mov    0xf0(%rsp),%rbx
11a8: mov    0x10(%rbx),%rax
11ac: test   %rax,%rax
11af: je     LOCAL+0x11cd
11b1: mov    0x8(%rbx),%rcx
11b5: mov    $0x7f,%edx
11ba: bsr    -0x8(%rcx,%rax,8),%rdx
11c0: xor    $0x3f,%rdx
11c4: shl    $0x6,%rax
11c8: sub    %rdx,%rax
11cb: jmp    LOCAL+0x11cf
11cd: xor    %eax,%eax
11cf: movb   $0x2,(%rsp)
11d3: movq   $0x0,0x8(%rsp)
11dc: mov    %rax,0x10(%rsp)
11e1: cmp    $0x1,%r15
11e5: je     LOCAL+0x15b1
11eb: mov    0x30(%rbx),%rax
11ef: test   %rax,%rax
11f2: je     LOCAL+0x1210
11f4: mov    0x28(%rbx),%rcx
11f8: mov    $0x7f,%edx
11fd: bsr    -0x8(%rcx,%rax,8),%rdx
1203: xor    $0x3f,%rdx
1207: shl    $0x6,%rax
120b: sub    %rdx,%rax
120e: jmp    LOCAL+0x1212
1210: xor    %eax,%eax
1212: movb   $0x2,0x20(%r13)
1217: movq   $0x0,0x28(%r13)
121f: mov    %rax,0x30(%r13)
1223: movups (%rsp),%xmm0
1227: movups 0x10(%rsp),%xmm1
122c: movups %xmm1,0x10(%r13)
1231: movups %xmm0,0x0(%r13)
1236: movq   $0x2,0x8(%rsp)
123f: mov    %r13,0x10(%rsp)
1244: movq   $0x2,0x18(%rsp)
124d: movb   $0x4,(%rsp)
1251: lea    0x30(%rsp),%rdi
1256: lea    0xb0(%rsp),%rsi
125e: lea    0x58(%rsp),%rdx
1263: mov    %rsp,%r14
1266: mov    %r14,%rcx
1269: call   TARGET<<alloc::collections::btree::map::BTreeMap<alloc::string::String, serde_json::value::Value>>::insert>
126e: cmpb   $0xff,0x30(%rsp)
1273: je     LOCAL+0x127f
1275: lea    0x30(%rsp),%rdi
127a: call   TARGET<core::ptr::drop_glue::<serde_json::value::Value>>
127f: movups 0xb0(%rsp),%xmm0
1287: movups %xmm0,0x8(%rsp)
128c: mov    0xc0(%rsp),%rax
1294: mov    %rax,0x18(%rsp)
1299: movb   $0x5,(%rsp)
129d: mov    %r14,0x30(%rsp)
12a2: mov    RIP_ADDRESS(%rip),%rax
12a9: mov    %rax,0x38(%rsp)
12ae: lea    RIP_ADDRESS(%rip),%rdi
12b5: lea    0x30(%rsp),%rsi
12ba: call   *RIP_ADDRESS(%rip)
12c0: mov    %rsp,%rdi
12c3: call   TARGET<core::ptr::drop_glue::<serde_json::value::Value>>
12c8: lea    0x8(%rbx),%r12
12cc: mov    RIP_ADDRESS(%rip),%r14
12d3: jmp    LOCAL+0x12e9
12d5: data16 cs nopw 0x0(%rax,%rax,1)
12e0: add    $0x20,%r12
12e4: dec    %r15
12e7: je     LOCAL+0x1305
12e9: mov    -0x8(%r12),%rsi
12ee: test   %rsi,%rsi
12f1: je     LOCAL+0x12e0
12f3: mov    (%r12),%rdi
12f7: shl    $0x3,%rsi
12fb: mov    $0x8,%edx
1300: call   *%r14
1303: jmp    LOCAL+0x12e0
1305: mov    0xe8(%rsp),%rsi
130d: test   %rsi,%rsi
1310: je     LOCAL+0x1324
1312: shl    $0x5,%rsi
1316: mov    $0x8,%edx
131b: mov    %rbx,%rdi
131e: call   *RIP_ADDRESS(%rip)
1324: lea    0x90(%rsp),%rdi
132c: call   TARGET<core::ptr::drop_glue::<[hyperreal::computable::node::Computable; 2]>>
1331: mov    0xc8(%rsp),%rsi
1339: test   %rsi,%rsi
133c: je     LOCAL+0x1352
133e: shl    $0x3,%rsi
1342: mov    $0x8,%edx
1347: mov    0x78(%rsp),%rdi
134c: call   *RIP_ADDRESS(%rip)
1352: mov    0xd8(%rsp),%rbx
135a: mov    0xe0(%rsp),%r15
1362: test   %r15,%r15
1365: je     LOCAL+0x1391
1367: lea    0x8(%rbx),%r12
136b: jmp    LOCAL+0x1379
136d: nopl   (%rax)
1370: add    $0x18,%r12
1374: dec    %r15
1377: je     LOCAL+0x1391
1379: mov    -0x8(%r12),%rsi
137e: test   %rsi,%rsi
1381: je     LOCAL+0x1370
1383: mov    (%r12),%rdi
1387: mov    $0x1,%edx
138c: call   *%r14
138f: jmp    LOCAL+0x1370
1391: mov    0xd0(%rsp),%rax
1399: test   %rax,%rax
139c: je     LOCAL+0x13b4
139e: shl    $0x3,%rax
13a2: lea    (%rax,%rax,2),%rsi
13a6: mov    $0x8,%edx
13ab: mov    %rbx,%rdi
13ae: call   *RIP_ADDRESS(%rip)
13b4: add    $0x138,%rsp
13bb: pop    %rbx
13bc: pop    %r12
13be: pop    %r13
13c0: pop    %r14
13c2: pop    %r15
13c4: pop    %rbp
13c5: ret
13c6: movzbl 0x8(%rsp),%eax
13cb: mov    %al,0x30(%rsp)
13cf: lea    RIP_ADDRESS(%rip),%rdi
13d6: lea    RIP_ADDRESS(%rip),%rcx
13dd: lea    RIP_ADDRESS(%rip),%r8
13e4: lea    0x30(%rsp),%rdx
13e9: mov    $0x2b,%esi
13ee: call   *RIP_ADDRESS(%rip)
13f4: jmp    LOCAL+0x15e8
13f9: add    $0xd0,%dl
13fc: xor    %eax,%eax
13fe: cmp    $0xa,%dl
1401: adc    $0x1,%al
1403: mov    %al,(%rsp)
1406: lea    RIP_ADDRESS(%rip),%rdi
140d: lea    RIP_ADDRESS(%rip),%rcx
1414: lea    RIP_ADDRESS(%rip),%r8
141b: mov    %rsp,%rdx
141e: mov    $0x2b,%esi
1423: call   *RIP_ADDRESS(%rip)
1429: jmp    LOCAL+0x15e8
142e: mov    $0x8,%edx
1433: mov    %rbx,%rdi
1436: mov    %r13,%rsi
1439: call   *RIP_ADDRESS(%rip)
143f: movups RIP_ADDRESS(%rip),%xmm0
1446: movaps %xmm0,(%rsp)
144a: movups RIP_ADDRESS(%rip),%xmm0
1451: movaps %xmm0,0x10(%rsp)
1456: jmp    LOCAL+0x886
145b: movzbl 0x8(%rsp),%eax
1460: mov    %al,0x90(%rsp)
1467: lea    RIP_ADDRESS(%rip),%rdi
146e: lea    RIP_ADDRESS(%rip),%rcx
1475: lea    RIP_ADDRESS(%rip),%r8
147c: lea    0x90(%rsp),%rdx
1484: mov    $0x2b,%esi
1489: call   *RIP_ADDRESS(%rip)
148f: jmp    LOCAL+0x15e8
1494: movzbl 0x8(%rsp),%eax
1499: mov    %al,0x30(%rsp)
149d: lea    RIP_ADDRESS(%rip),%rdi
14a4: lea    RIP_ADDRESS(%rip),%rcx
14ab: lea    RIP_ADDRESS(%rip),%r8
14b2: lea    0x30(%rsp),%rdx
14b7: mov    $0x2b,%esi
14bc: call   *RIP_ADDRESS(%rip)
14c2: jmp    LOCAL+0x15e8
14c7: lea    RIP_ADDRESS(%rip),%r9
14ce: lea    0x100(%rsp),%rsi
14d6: lea    0x110(%rsp),%rdx
14de: xor    %edi,%edi
14e0: xor    %ecx,%ecx
14e2: call   *RIP_ADDRESS(%rip)
14e8: jmp    LOCAL+0x15e8
14ed: mov    $0x8,%edi
14f2: mov    $0x40,%esi
14f7: call   *RIP_ADDRESS(%rip)
14fd: jmp    LOCAL+0x15e8
1502: lea    RIP_ADDRESS(%rip),%rdi
1509: lea    RIP_ADDRESS(%rip),%rdx
1510: mov    $0x21,%esi
1515: call   *RIP_ADDRESS(%rip)
151b: jmp    LOCAL+0x15e8
1520: mov    $0x1,%al
1522: jmp    LOCAL+0x1403
1527: lea    RIP_ADDRESS(%rip),%rdx
152e: call   *RIP_ADDRESS(%rip)
1534: jmp    LOCAL+0x15e8
1539: mov    %r12,0x28(%rsp)
153e: lea    RIP_ADDRESS(%rip),%rdi
1545: lea    RIP_ADDRESS(%rip),%rdx
154c: mov    $0x49,%esi
1551: call   *RIP_ADDRESS(%rip)
1557: jmp    LOCAL+0x15e8
155c: mov    $0x1,%edi
1561: mov    %rbx,%rsi
1564: call   *RIP_ADDRESS(%rip)
156a: jmp    LOCAL+0x15e8
156c: lea    RIP_ADDRESS(%rip),%rdx
1573: jmp    LOCAL+0x157c
1575: lea    RIP_ADDRESS(%rip),%rdx
157c: mov    %rdi,%rsi
157f: call   *RIP_ADDRESS(%rip)
1585: jmp    LOCAL+0x15e8
1587: mov    $0x1,%edi
158c: mov    %rbx,%rsi
158f: call   *RIP_ADDRESS(%rip)
1595: jmp    LOCAL+0x15e8
1597: xor    %eax,%eax
1599: jmp    LOCAL+0x1403
159e: lea    RIP_ADDRESS(%rip),%rdx
15a5: xor    %edi,%edi
15a7: xor    %esi,%esi
15a9: call   *RIP_ADDRESS(%rip)
15af: jmp    LOCAL+0x15e8
15b1: lea    RIP_ADDRESS(%rip),%rdx
15b8: mov    $0x1,%edi
15bd: mov    $0x1,%esi
15c2: call   *RIP_ADDRESS(%rip)
15c8: jmp    LOCAL+0x15e8
15ca: mov    $0x1,%edi
15cf: mov    %rbx,%rsi
15d2: call   *RIP_ADDRESS(%rip)
15d8: jmp    LOCAL+0x15e8
15da: mov    $0x8,%edi
15df: mov    %r12,%rsi
15e2: call   *RIP_ADDRESS(%rip)
15e8: ud2
15ea: mov    %rax,%r15
15ed: jmp    LOCAL+0x1802
15f2: jmp    LOCAL+0x15fc
15f4: mov    %r14,0x88(%rsp)
15fc: mov    %r12,0x28(%rsp)
1601: mov    %rax,%r15
1604: mov    (%rsp),%rsi
1608: test   %rsi,%rsi
160b: je     LOCAL+0x1813
1611: mov    0x8(%rsp),%rdi
1616: shl    $0x3,%rsi
161a: mov    $0x8,%edx
161f: jmp    LOCAL+0x180d
1624: mov    %rax,%r15
1627: mov    (%rsp),%rsi
162b: test   %rsi,%rsi
162e: je     LOCAL+0x18e6
1634: mov    0x8(%rsp),%rdi
1639: shl    $0x3,%rsi
163d: mov    $0x8,%edx
1642: call   *RIP_ADDRESS(%rip)
1648: jmp    LOCAL+0x18e6
164d: mov    %rax,%r15
1650: mov    (%rsp),%rsi
1654: jmp    LOCAL+0x165e
1656: mov    %rax,%r15
1659: mov    0x30(%rsp),%rsi
165e: test   %rsi,%rsi
1661: je     LOCAL+0x1730
1667: mov    (%r14),%rdi
166a: shl    $0x3,%rsi
166e: mov    $0x8,%edx
1673: call   *RIP_ADDRESS(%rip)
1679: jmp    LOCAL+0x1730
167e: mov    %rax,%r15
1681: mov    $0xa,%esi
1686: mov    $0x1,%edx
168b: mov    %rbp,%rdi
168e: call   *RIP_ADDRESS(%rip)
1694: jmp    LOCAL+0x16fc
1696: jmp    LOCAL+0x16f0
1698: mov    %rax,%r15
169b: jmp    LOCAL+0x1730
16a0: mov    %rax,%r15
16a3: mov    %rsp,%rdi
16a6: call   TARGET<core::ptr::drop_glue::<serde_json::value::Value>>
16ab: jmp    LOCAL+0x16b0
16ad: mov    %rax,%r15
16b0: mov    $0x40,%esi
16b5: mov    $0x8,%edx
16ba: mov    %r13,%rdi
16bd: call   *RIP_ADDRESS(%rip)
16c3: jmp    LOCAL+0x1845
16c8: mov    %rax,%r15
16cb: jmp    LOCAL+0x18e6
16d0: mov    %rax,%r15
16d3: mov    %rsp,%rdi
16d6: call   TARGET<core::ptr::drop_glue::<serde_json::value::Value>>
16db: jmp    LOCAL+0x18a8
16e0: mov    %rax,%r15
16e3: jmp    LOCAL+0x189b
16e8: mov    %rax,%r15
16eb: jmp    LOCAL+0x189b
16f0: mov    %rax,%r15
16f3: test   %rbx,%rbx
16f6: je     LOCAL+0x189b
16fc: mov    $0x1,%edx
1701: mov    %r13,%rdi
1704: mov    %rbx,%rsi
1707: jmp    LOCAL+0x1895
170c: mov    %rax,%r15
170f: mov    0x98(%rsp),%rax
1717: test   %rax,%rax
171a: je     LOCAL+0x1730
171c: lock decq (%rax)
1720: jne    LOCAL+0x1730
1722: lea    0x98(%rsp),%rdi
172a: call   *RIP_ADDRESS(%rip)
1730: test   %r13,%r13
1733: je     LOCAL+0x18e6
1739: shl    $0x3,%r13
173d: mov    $0x8,%edx
1742: mov    0x28(%rsp),%rdi
1747: mov    %r13,%rsi
174a: call   *RIP_ADDRESS(%rip)
1750: jmp    LOCAL+0x18e6
1755: call   *RIP_ADDRESS(%rip)
175b: mov    %rax,%r15
175e: mov    0x38(%rsp),%rax
1763: test   %rax,%rax
1766: je     LOCAL+0x18e6
176c: lock decq (%rax)
1770: jne    LOCAL+0x18e6
1776: mov    %rbx,%rdi
1779: call   *RIP_ADDRESS(%rip)
177f: jmp    LOCAL+0x18e6
1784: call   *RIP_ADDRESS(%rip)
178a: mov    %rax,%r15
178d: mov    $0x4,%esi
1792: mov    $0x1,%edx
1797: mov    0x28(%rsp),%rdi
179c: jmp    LOCAL+0x1895
17a1: mov    %rax,%r15
17a4: jmp    LOCAL+0x189b
17a9: mov    %rax,%r15
17ac: jmp    LOCAL+0x189b
17b1: mov    %rax,%r15
17b4: jmp    LOCAL+0x189b
17b9: mov    %rax,%r15
17bc: jmp    LOCAL+0x189b
17c1: mov    %rax,%r15
17c4: jmp    LOCAL+0x18d9
17c9: mov    %rax,%r15
17cc: lea    0x118(%rsp),%rdi
17d4: call   TARGET<core::ptr::drop_glue::<hyperreal::computable::node::Computable>>
17d9: jmp    LOCAL+0x18e6
17de: mov    %rax,%r15
17e1: jmp    LOCAL+0x18e6
17e6: mov    %rax,%r15
17e9: jmp    LOCAL+0x18e6
17ee: mov    %rax,%r15
17f1: jmp    LOCAL+0x189b
17f6: mov    %rax,%r15
17f9: test   %r13,%r13
17fc: je     LOCAL+0x1813
17fe: shl    $0x3,%r13
1802: mov    $0x8,%edx
1807: mov    %rbx,%rdi
180a: mov    %r13,%rsi
180d: call   *RIP_ADDRESS(%rip)
1813: cmpq   $0x0,0x28(%rsp)
1819: je     LOCAL+0x18e6
181f: mov    0x28(%rsp),%rsi
1824: shl    $0x3,%rsi
1828: mov    $0x8,%edx
182d: mov    0x88(%rsp),%rdi
1835: call   *RIP_ADDRESS(%rip)
183b: jmp    LOCAL+0x18e6
1840: jmp    LOCAL+0x1878
1842: mov    %rax,%r15
1845: mov    $0xd,%esi
184a: mov    $0x1,%edx
184f: mov    %r12,%rdi
1852: jmp    LOCAL+0x1895
1854: mov    %rax,%r15
1857: lea    0x30(%rsp),%rdi
185c: call   TARGET<core::ptr::drop_glue::<hyperreal::computable::node::Computable>>
1861: jmp    LOCAL+0x1907
1866: mov    %rax,%r15
1869: lea    0x90(%rsp),%rdi
1871: call   TARGET<core::ptr::drop_glue::<hyperreal::computable::node::Computable>>
1876: jmp    LOCAL+0x18e6
1878: mov    %rax,%r15
187b: jmp    LOCAL+0x18a8
187d: mov    %rax,%r15
1880: jmp    LOCAL+0x1907
1885: mov    %rax,%r15
1888: mov    $0xa,%esi
188d: mov    $0x1,%edx
1892: mov    %rbp,%rdi
1895: call   *RIP_ADDRESS(%rip)
189b: lea    0xb0(%rsp),%rdi
18a3: call   TARGET<<alloc::collections::btree::map::BTreeMap<alloc::string::String, serde_json::value::Value> as core::ops::drop::Drop>::drop>
18a8: lea    0xe8(%rsp),%rdi
18b0: call   TARGET<<alloc::vec::Vec<num_bigint::bigint::BigInt> as core::ops::drop::Drop>::drop>
18b5: mov    0xe8(%rsp),%rsi
18bd: test   %rsi,%rsi
18c0: je     LOCAL+0x18d9
18c2: mov    0xf0(%rsp),%rdi
18ca: shl    $0x5,%rsi
18ce: mov    $0x8,%edx
18d3: call   *RIP_ADDRESS(%rip)
18d9: lea    0x90(%rsp),%rdi
18e1: call   TARGET<core::ptr::drop_glue::<[hyperreal::computable::node::Computable; 2]>>
18e6: mov    0xc8(%rsp),%rsi
18ee: test   %rsi,%rsi
18f1: je     LOCAL+0x1907
18f3: shl    $0x3,%rsi
18f7: mov    $0x8,%edx
18fc: mov    0x78(%rsp),%rdi
1901: call   *RIP_ADDRESS(%rip)
1907: mov    0xd8(%rsp),%rbx
190f: mov    0xe0(%rsp),%r14
1917: test   %r14,%r14
191a: jne    LOCAL+0x1947
191c: mov    0xd0(%rsp),%rax
1924: test   %rax,%rax
1927: je     LOCAL+0x193f
1929: shl    $0x3,%rax
192d: lea    (%rax,%rax,2),%rsi
1931: mov    $0x8,%edx
1936: mov    %rbx,%rdi
1939: call   *RIP_ADDRESS(%rip)
193f: mov    %r15,%rdi
1942: call   TARGET<_Unwind_Resume@plt>
1947: lea    0x8(%rbx),%r12
194b: mov    RIP_ADDRESS(%rip),%r13
1952: jmp    LOCAL+0x1969
1954: data16 data16 cs nopw 0x0(%rax,%rax,1)
1960: add    $0x18,%r12
1964: dec    %r14
1967: je     LOCAL+0x191c
1969: mov    -0x8(%r12),%rsi
196e: test   %rsi,%rsi
1971: je     LOCAL+0x1960
1973: mov    (%r12),%rdi
1977: mov    $0x1,%edx
197c: call   *%r13
197f: jmp    LOCAL+0x1960
1981: call   *RIP_ADDRESS(%rip)
